## src/2026-06-01_BLE_GATT_Service/boards/arm/my_custom_board/Kconfig.board
```kconfig
config BOARD_MY_CUSTOM_BOARD
	bool "My Custom nRF52840 Board"
	select SOC_NRF52840_QIAA
```

## src/2026-06-01_BLE_GATT_Service/boards/arm/my_custom_board/Kconfig.defconfig
```kconfig
if BOARD_MY_CUSTOM_BOARD

config BOARD
	default "my_custom_board"

endif # BOARD_MY_CUSTOM_BOARD
```

## src/2026-06-01_KXTJ3_CBOR_Custom_PCB/boards/arm/my_custom_board/my_custom_board_defconfig
```kconfig
CONFIG_SOC_SERIES_NRF52X=y
CONFIG_SOC_NRF52840_QIAA=y
CONFIG_BOARD_MY_CUSTOM_BOARD=y
CONFIG_SYS_CLOCK_HW_CYCLES_PER_SEC=64000000
CONFIG_GPIO=y
CONFIG_SERIAL=y
CONFIG_UART_NRFX=y
CONFIG_PINCTRL=y
CONFIG_I2C=y
CONFIG_USB_DEVICE_STACK=y
```
