## CMakeLists.txt
```
cmake_minimum_required(VERSION 3.13.1)
find_package(Zephyr REQUIRED HINTS $ENV{ZEPHYR_BASE})
project(2026-06-04_ADC_Reading)

target_sources(app PRIVATE src/main.c)
```

## prj.conf
```kconfig
CONFIG_ADC=y
CONFIG_LOG=y
CONFIG_LOG_DEFAULT_LEVEL=3
CONFIG_COMMON_LIBC_MALLOC_ARENA_SIZE=0
```

## app.overlay
```dts
/*
 * ADC channel 0 on AIN2 (P0.04).
 * Wire a potentiometer wiper or analog signal to P0.04.
 * Voltage range: 0 to ~3.6V with 1/6 gain and internal reference.
 */
/ {
	zephyr,user {
		io-channels = <&adc 2>;
	};
};

&adc {
	status = "okay";
	#address-cells = <1>;
	#size-cells = <0>;

	channel@2 {
		reg = <2>;
		zephyr,gain              = "ADC_GAIN_1_6";
		zephyr,reference         = "ADC_REF_INTERNAL";
		zephyr,acquisition-time  = <ADC_ACQ_TIME_DEFAULT>;
		zephyr,input-positive    = <NRF_SAADC_AIN2>;
		zephyr,resolution        = <12>;
	};
};
```

## src/main.c
```c
#include <zephyr/kernel.h>
#include <zephyr/drivers/adc.h>
#include <zephyr/logging/log.h>

LOG_MODULE_REGISTER(day20, LOG_LEVEL_INF);

static const struct adc_dt_spec adc_ch =
    ADC_DT_SPEC_GET(DT_PATH(zephyr_user));

int main(void)
{
    if (!adc_is_ready_dt(&adc_ch)) {
        LOG_ERR("Day 20: ADC not ready");
        return;
    }

    int rc = adc_channel_setup_dt(&adc_ch);
    if (rc) {
        LOG_ERR("ADC channel setup failed: %d", rc);
        return;
    }

    LOG_INF("Day 20: ADC ready on AIN2 (P0.04), reading every 1 s");

    int16_t raw;
    struct adc_sequence seq = {
        .buffer      = &raw,
        .buffer_size = sizeof(raw),
    };
    adc_sequence_init_dt(&adc_ch, &seq);

    while (1) {
        rc = adc_read(adc_ch.dev, &seq);
        if (rc) {
            LOG_ERR("ADC read failed: %d", rc);
        } else {
            int32_t mv = raw;
            adc_raw_to_millivolts_dt(&adc_ch, &mv);
            LOG_INF("raw=%5d   voltage=%4d mV", raw, mv);
        }
        k_msleep(1000);
    }
    return 0;
}
```
