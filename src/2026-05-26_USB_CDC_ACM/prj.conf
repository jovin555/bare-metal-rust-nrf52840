## CMakeLists.txt
```
cmake_minimum_required(VERSION 3.13.1)
find_package(Zephyr REQUIRED HINTS $ENV{ZEPHYR_BASE})
project(2026-05-26_USB_CDC_ACM)

target_sources(app PRIVATE src/main.c)
```

## prj.conf
```kconfig
CONFIG_USB_DEVICE_STACK=y
CONFIG_USB_DEVICE_PRODUCT="My Zephyr USB Device"
CONFIG_USB_DEVICE_VID=0x2FE3
CONFIG_USB_DEVICE_PID=0x0100
CONFIG_USB_CDC_ACM=y
CONFIG_UART_LINE_CTRL=y
CONFIG_USB_UART_CONSOLE=y
CONFIG_UART_CONSOLE=y
CONFIG_LOG=y
CONFIG_LOG_DEFAULT_LEVEL=3
CONFIG_LOG_BACKEND_UART=y
CONFIG_COMMON_LIBC_MALLOC_ARENA_SIZE=0
```

## src/main.c
```c
#include <zephyr/kernel.h>
#include <zephyr/usb/usb_device.h>
#include <zephyr/drivers/uart.h>
#include <zephyr/logging/log.h>

LOG_MODULE_REGISTER(day11, LOG_LEVEL_INF);

static const struct device *usb_uart = DEVICE_DT_GET(DT_NODELABEL(cdc_acm_uart0));

int main(void)
{
    if (!device_is_ready(usb_uart)) {
        return;
    }

    if (usb_enable(NULL) != 0) {
        return;
    }

    /* Wait until the host opens the COM port (DTR goes high) */
    uint32_t dtr = 0;
    while (!dtr) {
        uart_line_ctrl_get(usb_uart, UART_LINE_CTRL_DTR, &dtr);
        k_msleep(100);
    }

    LOG_INF("Day 11: USB CDC-ACM ready");

    int count = 0;
    uint8_t rx_buf[64];

    while (1) {
        /* Send a counter line every second */
        printk("count: %d\n", count++);

        /* Echo any received bytes */
        int len = uart_fifo_read(usb_uart, rx_buf, sizeof(rx_buf) - 1);
        if (len > 0) {
            rx_buf[len] = '\0';
            printk("echo: %s\n", rx_buf);
        }

        k_msleep(1000);
    }
    return 0;
}
```
