## CMakeLists.txt
```
cmake_minimum_required(VERSION 3.13.1)
find_package(Zephyr REQUIRED HINTS $ENV{ZEPHYR_BASE})
project(2026-05-20_Basic_Zephyr_Application)

target_sources(app PRIVATE src/main.c)
```

## prj.conf
```kconfig
CONFIG_PRINTK=y
CONFIG_COMMON_LIBC_MALLOC_ARENA_SIZE=0
CONFIG_MAIN_STACK_SIZE=2048
```

## src/main.c
```c
#include <zephyr/kernel.h>
#include <zephyr/sys/printk.h>

int main(void)
{
    int count = 0;
    while (1) {
        printk("Day 5: Hello from Zephyr app loop (%d)!\n", count++);
        k_sleep(K_SECONDS(1));
    }
    return 0;
}
```
