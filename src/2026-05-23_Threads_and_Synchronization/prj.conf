## CMakeLists.txt
```
cmake_minimum_required(VERSION 3.13.1)
find_package(Zephyr REQUIRED HINTS $ENV{ZEPHYR_BASE})
project(2026-05-23_Threads_and_Synchronization)

target_sources(app PRIVATE src/main.c)
```

## prj.conf
```kconfig
CONFIG_LOG=y
CONFIG_LOG_DEFAULT_LEVEL=3
CONFIG_COMMON_LIBC_MALLOC_ARENA_SIZE=0
```

## src/main.c
```c
#include <zephyr/kernel.h>
#include <zephyr/logging/log.h>

LOG_MODULE_REGISTER(day8, LOG_LEVEL_INF);

K_MSGQ_DEFINE(counter_queue, sizeof(int), 10, 4);

void producer_fn(void *a, void *b, void *c)
{
    int count = 0;

    while (1) {
        k_msgq_put(&counter_queue, &count, K_NO_WAIT);
        count++;
        k_msleep(1000);
    }
}

void consumer_fn(void *a, void *b, void *c)
{
    int value;

    while (1) {
        k_msgq_get(&counter_queue, &value, K_FOREVER);
        LOG_INF("Day 8: received %d", value);
    }
}

K_THREAD_DEFINE(producer, 1024, producer_fn, NULL, NULL, NULL, 5, 0, 0);
K_THREAD_DEFINE(consumer, 1024, consumer_fn, NULL, NULL, NULL, 5, 0, 0);

int main(void)
{
    LOG_INF("Day 8: threads and synchronization started");
    return 0;
}
```
