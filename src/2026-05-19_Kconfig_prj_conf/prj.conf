## CMakeLists.txt
```
cmake_minimum_required(VERSION 3.13.1)
find_package(Zephyr REQUIRED HINTS $ENV{ZEPHYR_BASE})
project(2026-05-19_Kconfig_prj_conf)

target_sources(app PRIVATE src/main.c)
```

## Kconfig
```
mainmenu "Day 4 — Kconfig and prj.conf"

config DAY4_GREETING
    string "Custom greeting message printed at startup"
    default "Hello from Kconfig!"

config DAY4_SLEEP_INTERVAL_MS
    int "Sleep interval between log messages (ms)"
    default 1000
    range 100 10000
```

## prj.conf
```kconfig
CONFIG_PRINTK=y
CONFIG_COMMON_LIBC_MALLOC_ARENA_SIZE=0
CONFIG_LOG=y
CONFIG_LOG_DEFAULT_LEVEL=3
CONFIG_MAIN_STACK_SIZE=2048

# Custom Kconfig options defined in ./Kconfig
CONFIG_DAY4_GREETING="Kconfig is working!"
CONFIG_DAY4_SLEEP_INTERVAL_MS=500
```

## src/main.c
```c
#include <zephyr/kernel.h>
#include <zephyr/logging/log.h>

LOG_MODULE_REGISTER(day4, LOG_LEVEL_INF);

int main(void)
{
    LOG_INF("Day 4: greeting = \"%s\"", CONFIG_DAY4_GREETING);
    LOG_INF("Day 4: sleep interval = %d ms  (change via prj.conf)",
            CONFIG_DAY4_SLEEP_INTERVAL_MS);

    while (1) {
        LOG_INF("tick — sleeping %d ms", CONFIG_DAY4_SLEEP_INTERVAL_MS);
        k_msleep(CONFIG_DAY4_SLEEP_INTERVAL_MS);
    }
    return 0;
}
```
