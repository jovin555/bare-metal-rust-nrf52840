## CMakeLists.txt
```
cmake_minimum_required(VERSION 3.13.1)
find_package(Zephyr REQUIRED HINTS $ENV{ZEPHYR_BASE})
project(2026-05-21_Zephyr_Drivers_and_Binding)

target_sources(app PRIVATE src/main.c)
```

## prj.conf
```kconfig
CONFIG_PRINTK=y
CONFIG_COMMON_LIBC_MALLOC_ARENA_SIZE=0
CONFIG_SERIAL=y
CONFIG_MAIN_STACK_SIZE=2048
```

## src/main.c
```c
#include <zephyr/kernel.h>
#include <zephyr/sys/printk.h>
#include <zephyr/device.h>
#include <zephyr/devicetree.h>
#include <zephyr/drivers/uart.h>

int main(void)
{
    const struct device *uart = DEVICE_DT_GET(DT_NODELABEL(uart0));

    if (!device_is_ready(uart)) {
        printk("Day 6: uart0 is not ready.\n");
        return;
    }

    printk("Day 6: uart0 is ready. Sending test output...\n");
    uart_poll_out(uart, 'Z');
    uart_poll_out(uart, '\n');
    while (1) {
        k_sleep(K_SECONDS(2));
    }
    return 0;
}
```
